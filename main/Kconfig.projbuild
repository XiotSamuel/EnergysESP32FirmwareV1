## main/Kconfig.projbuild
```kconfig
menu "Firmware Configuration"

    menu "WS2182 Config"
        config RMT_TX_GPIO
            int "RMT TX GPIO"
            default 27
            help
                Set the GPIO number used for transmitting the RMT signal.
        
        config RMT_TX_CHANNEL
            int "RMT TX CHANNEL"
            default 0
            help
                Set the RMT TX Channel for LED control only 0 is require.

        config STRIP_LED_NUMBER
            int "Number of LEDS in a strip"
            default 1
            help
                A single RGB strip contains several LEDs.
    
        config CHASE_SPEED_MS
            int "Speed for changing LED colour"
            default 1000
            help
                Speed for chaning LED colour
    endmenu

    menu "AS312 config"
        config AS312_ENABLE
                bool "Enable AS312"
                default y
                help
                    enable AS312 sensor
        config AS312_DATA
            int "AS312 Data GPIO Num"
            default 34 if IDF_TARGET_ESP32
            help
                AS312 data GPIO pin number

    endmenu

    menu "BH1750 config"
        config BH1750_ENABLE
            bool "Enable BH1750"
            default y
            help
                enable BH1750 sensor
        config I2C_MASTER_SCL
            int "SCL GPIO Num"
            default 6 if IDF_TARGET_ESP32C3
            default 19 if IDF_TARGET_ESP32 || IDF_TARGET_ESP32S2 || IDF_TARGET_ESP32S3
            help
                GPIO number for I2C Master clock line.
    
        config I2C_MASTER_SDA
            int "SDA GPIO Num"
            default 5 if IDF_TARGET_ESP32C3
            default 18 if IDF_TARGET_ESP32 || IDF_TARGET_ESP32S2 || IDF_TARGET_ESP32S3
            help
                GPIO number for I2C Master data line.
            

        choice BH1750_MEASURE_MODE
            bool "Specify the light sensor operation mode"
            default BH1750_CONTINUE_1LX_RES
            help 
                Specify the light sensor operation mode
                BH1750_CONTINUE_1LX_RES = "Continuously H-Resolution mode"
                BH1750_CONTINUE_HALFLX_RES = "Continuously H-Resolution mode2"
                BH1750_CONTINUE_4LX_RES  = "Continuously L-Resolution mode"
            config BH1750_CONTINUE_1LX_RES
            bool "Continuously H-Resolution mode"
            config BH1750_CONTINUE_HALFLX_RES
            bool "Continuously H-Resolution mode2"
            config BH1750_CONTINUE_4LX_RES 
            bool "Continuously L-Resolution mode"
            
        endchoice
              
    endmenu

    menu "MQTT config"

        config MQTT_URL
            string "MQTT broker URL"
            default "mqtt://user2:Qazw123$@staging.energysmeter.com:1883"
            help
                URL of the broker to connect to

        config MQTT_USERNAME
            string "MQTT username"
            default "user2"
            help
                password
        
        config MQTT_PASSWORD
            string "MQTT password"
            default "Qazw123$"
            help
                password
        
        config BROKER_CERTIFICATE_OVERRIDE
            string "Broker certificate override"
            default ""
            help
                Please leave empty if broker certificate included from a textfile; otherwise fill in a base64 part of PEM
                format certificate
    
        config BROKER_CERTIFICATE_OVERRIDDEN
            bool
            default y if BROKER_CERTIFICATE_OVERRIDE != ""
    
        config BROKER_BIN_SIZE_TO_SEND
            # This option is not visible and is used only to set parameters for example tests
            # Here we configure the data size to send and to be expected in the python script
            int
            default 20000

    endmenu

    menu "light driver config"
        config LIGHT_GPIO_RED
            int "Light red pin GPIO number"
            range 0 33
            default 4 if IDF_TARGET_ESP32
            default 4 if IDF_TARGET_ESP32C3
            help
                There are more enumerations like that
                up to GPIO39, excluding GPIO20, GPIO24 and GPIO28..31.
                They are not shown here to reduce redundant information.
                @note GPIO34..39 are input mode only.
        
        config LIGHT_GPIO_GREEN
            int "Light green pin GPIO number"
            range 0 33
            default 16 if IDF_TARGET_ESP32
            default 5 if IDF_TARGET_ESP32C3
            help
                There are more enumerations like that
                up to GPIO39, excluding GPIO20, GPIO24 and GPIO28..31.
                They are not shown here to reduce redundant information.
                @note GPIO34..39 are input mode only.
        
        config LIGHT_GPIO_BLUE
            int "Light blue pin GPIO number"
            range 0 33
            default 5 if IDF_TARGET_ESP32
            default 6 if IDF_TARGET_ESP32C3
            help
                There are more enumerations like that
                up to GPIO39, excluding GPIO20, GPIO24 and GPIO28..31.
                They are not shown here to reduce redundant information.
                @note GPIO34..39 are input mode only.
        
        config LIGHT_GPIO_COLD
            int "Light cold colors pin GPIO number"
            range 0 33
            default 19 if IDF_TARGET_ESP32
            default 7 if IDF_TARGET_ESP32C3
            help
                There are more enumerations like that
                up to GPIO39, excluding GPIO20, GPIO24 and GPIO28..31.
                They are not shown here to reduce redundant information.
                @note GPIO34..39 are input mode only.
        
        config LIGHT_GPIO_WARM
            int "Light warm color pin GPIO number"
            range 0 33
            default 23 if IDF_TARGET_ESP32
            default 10 if IDF_TARGET_ESP32C3
            help
                There are more enumerations like that
                up to GPIO39, excluding GPIO20, GPIO24 and GPIO28..31.
                They are not shown here to reduce redundant information.
                @note GPIO34..39 are input mode only.
        
        config LIGHT_FADE_PERIOD_MS
            int "The time from the current color to the next color"
            default 500
            help
                The time from the current color to the next color.
        
        config LIGHT_BLINK_PERIOD_MS
            int "Period of blinking lights"
            default 2000
            help
                Period of blinking lights.

        config LIGHT_AUTO_OFF
            int "Period of light auto off"
            default 3000
            help
                period of light auto off.
    endmenu

    choice LIGHT_EXAMPLE_MODE
        bool "Select light example mode"
        default LIGHT_EXAMPLE_MESH
        help 
            Specify which light example to build,support mesh-light or mesh-light with aliyun
        config LIGHT_EXAMPLE_MESH
        bool "mesh light"
        config LIGHT_EXAMPLE_ALIYUN
        bool "mesh light with aliyun"
        
    endchoice

    config LIGHT_EXAMPLE_MODE
        int
        default 0 if LIGHT_EXAMPLE_MESH
        default 1 if LIGHT_EXAMPLE_ALIYUN

    menu "mesh light config"
        depends on LIGHT_EXAMPLE_MESH
        config LIGHT_VERSION
            string "Light version"
            default "1.2.2"
            help
                Version of the five-color light
        
        config LIGHT_MEMORY_DEBUG
            bool "Enable memory debugging"
            default n
            help
                Enable memory debugging.
        
        config LIGHT_BLE_GATEWAY
            bool "Enable the BLE gateway on the non-root node"
            default n
            help
                Enabling the BLE gateway on a non-root node,
                enabling the BLE gateway will consume a lot of memory.
    
        config LIGHT_NETWORKING_TIME_OPTIMIZE_ENABLE
            bool "Optimize networking time"
            default n
            help
                1. Set the Bluetooth configuration network device to a fixed root node, eliminating the time of competing for the root node
                2. Once the networking is complete, select again whether there is a better root node.
                3. When power is turned on again, the device that was the root node last time is selected as the root node by default.
        
        config LIGHT_RESTART_COUNT_RESET
            int "Reset the number of times the device has been powered off continuously to enter the configured network mode"
            range 3 10
            default 5
            help
                Reset the number of times the device has been powered off continuously to enter the configured network mode.
        
        config LIGHT_RESTART_COUNT_FALLBACK
            int "Number of times the device restarted abnormally, entered, and exited from the previous version"
            range 15 32
            default 15
            help
                Number of times the device restarted abnormally, entered, and exited from the previous version.
    
    endmenu



endmenu
```

## sdkconfig.defaults
```kconfig
# Override some defaults in mesh application project.

#
# Serial flasher config
#
CONFIG_ESPTOOLPY_FLASHSIZE_4MB=y

#
# Partition Table
#
CONFIG_PARTITION_TABLE_CUSTOM=y

#
# Wi-Fi
#
CONFIG_ESP32_WIFI_AMPDU_TX_ENABLED=
CONFIG_ESP32_WIFI_AMPDU_RX_ENABLED=
CONFIG_ESP_WIFI_FTM_INITIATOR_SUPPORT=n
CONFIG_ESP_WIFI_FTM_RESPONDER_SUPPORT=n

#
# FreeRTOS
#
CONFIG_FREERTOS_HZ=1000
CONFIG_FREERTOS_UNICORE=y
CONFIG_FREERTOS_TIMER_TASK_STACK_DEPTH=3072
CONFIG_FREERTOS_USE_TRACE_FACILITY=y
CONFIG_FREERTOS_USE_STATS_FORMATTING_FUNCTIONS=y
CONFIG_FREERTOS_VTASKLIST_INCLUDE_COREID=y
CONFIG_FREERTOS_GENERATE_RUN_TIME_STATS=y

#
# ESP32-specific
#
CONFIG_ESP_TASK_WDT_PANIC=y
CONFIG_ESP_TASK_WDT_TIMEOUT_S=30
CONFIG_ESP32_ENABLE_COREDUMP=y
CONFIG_ESP_TIMER_TASK_STACK_SIZE=4096

#
# Bluetooth
#
CONFIG_BT_ENABLED=y
CONFIG_GATTC_ENABLE=
CONFIG_BLE_SMP_ENABLE=
CONFIG_BT_ACL_CONNECTIONS=2
CONFIG_BLE_SCAN_DUPLICATE=
CONFIG_BT_BLE_DYNAMIC_ENV_MEMORY=y
CONFIG_BTDM_CONTROLLER_MODEM_SLEEP=
CONFIG_BT_STACK_NO_LOG=
CONFIG_BT_BLE_SMP_ENABLE=y
CONFIG_BT_BLE_BLUFI_ENABLE=y
CONFIG_BT_BLE_42_FEATURES_SUPPORTED=y

CONFIG_BTDM_CTRL_MODE_BLE_ONLY=y

#
# Bootloader config
#
CONFIG_BOOTLOADER_OFFSET_IN_FLASH=0x1000

#
# mbedTLS
#
CONFIG_MBEDTLS_HARDWARE_MPI=y
CONFIG_MBEDTLS_DYNAMIC_BUFFER=y
CONFIG_MBEDTLS_DYNAMIC_FREE_PEER_CERT=y
CONFIG_MBEDTLS_DYNAMIC_FREE_CONFIG_DATA=y
CONFIG_MBEDTLS_SSL_PROTO_TLS1=n
CONFIG_MBEDTLS_SSL_PROTO_TLS1_1=n
CONFIG_MBEDTLS_TLS_CLIENT_ONLY=y

#
# HTTP Server
#
CONFIG_HTTPD_MAX_REQ_HDR_LEN=4096

#
# MDF Mupgrade
#
CONFIG_MUPGRADE_FIRMWARE_CHECK=y
CONFIG_MUPGRADE_RESTART_COUNT=10
CONFIG_MUPGRADE_RESTART_TIMEOUT=500
CONFIG_MUPGRADE_VERSION_FALLBACK_FACTORY=

#
# mesh light config
#
CONFIG_LIGHT_VERSION="1.4.4-master"

# Compiler options
CONFIG_COMPILER_OPTIMIZATION_SIZE=y

# Newlib
# CONFIG_NEWLIB_NANO_FORMAT=y 

# Virtual file system
CONFIG_VFS_SUPPORT_DIR=n
CONFIG_VFS_SUPPORT_SELECT=n
CONFIG_VFS_SUPPORT_TERMIOS=n

# ESP NETIF Adapter
CONFIG_ESP_NETIF_TCPIP_ADAPTER_COMPATIBLE_LAYER=n

# Common ESP-related
CONFIG_ESP_ERR_TO_NAME_LOOKUP=n

# ESP-MQTT Configurations
CONFIG_MQTT_TRANSPORT_WEBSOCKET=n

# LWIP
# CONFIG_LWIP_IPV6=n

# Bootloader
CONFIG_BOOTLOADER_SKIP_VALIDATE_ALWAYS=y


#
# Firmware Configuration
#

#
# AS312 config
#
CONFIG_AS312_DATA=19
CONFIG_AS312_ENABLE=y
# end of AS312 config

#
# BH1750 config
#
CONFIG_I2C_MASTER_SCL=23
CONFIG_I2C_MASTER_SDA=22
#CONFIG_BH1750_CONTINUE_1LX_RES= 1
CONFIG_BH1750_CONTINUE_HALFLX_RES=y
#CONFIG_BH1750_CONTINUE_4LX_RES = "Continuously L-Resolution mode"
CONFIG_BH1750_ENABLE=y
# end of BH1750 config

#
# MQTT config
#
#CONFIG_MQTT_URL="mqtt://user1:Qazw123$@mqtt.energysmeter.com:8883"
CONFIG_MQTT_URL="mqtt://user2:Qazw123$@staging.energysmeter.com:1883"
CONFIG_MQTT_USERNAME="user2"
CONFIG_MQTT_PASSWORD="Qazw123$"
# end of MQTT config

#
# light driver config
#
CONFIG_LIGHT_GPIO_RED=25
CONFIG_LIGHT_GPIO_GREEN=21
CONFIG_LIGHT_GPIO_BLUE=26
CONFIG_LIGHT_GPIO_COLD=32
CONFIG_LIGHT_GPIO_WARM=33
CONFIG_LIGHT_FADE_PERIOD_MS=500
CONFIG_LIGHT_BLINK_PERIOD_MS=2000
CONFIG_LIGHT_AUTO_OFF=10000
# end of light driver config

#
# WS2812 config
#
CONFIG_RMT_TX_GPIO = 27
CONFIG_RMT_TX_CHANNEL = 0
CONFIG_STRIP_LED_NUMBER = 1
CONFIG_CHASE_SPEED_MS = 1000

# end of WS2812 config
```
